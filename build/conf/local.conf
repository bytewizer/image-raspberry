## build/conf/local.conf
```bitbake
#
# Machine Selection
#
MACHINE ??= "seeed-reterminal"

#
# Default policy config
#
DISTRO ?= "poky"

#
# Extra image configuration defaults
#
EXTRA_IMAGE_FEATURES ?= "debug-tweaks ssh-server-openssh"

#
# Additional image features
#
USER_CLASSES ?= "buildstats"

#
# Interactive shell configuration
#
PATCHRESOLVE = "noop"

#
# Enable sdimg format for flashing to sdcard
#
IMAGE_FSTYPES = "wic"
#IMAGE_FSTYPES = "wic.xz wic.bmap ext4.gz rpi-sdimg"

#
# Enable systemd in configuration
INIT_MANAGER = "systemd"

#
# Set root password
# using openssl passwd p@ssw0rd
#
# INHERIT += "extrausers"
# EXTRA_USERS_PARAMS = "usermod -p yKMNZ4imKnbb6 root;"
# INHERIT += "chageusers"
# CHAGE_USERS_PARAMS = "chage -d0 root; "

#
# Disable rpi boot logo
#
#DISABLE_RPI_BOOT_LOGO = "1"

#
# Enable u-boot kernel image
#
RPI_USE_U_BOOT = "1"

#
# Disable rainbow splash screen 
#
#DISABLE_SPLASH = "1"

#
# Enable the UART console access
#
ENABLE_UART = "1"

#
# Enable the SPI bus
#
ENABLE_SPI_BUS = "1"

#
# Enable the I2C and auto-load I2C kernel modules
#
ENABLE_I2C = "1"
KERNEL_MODULE_AUTOLOAD:rpi += "i2c-dev i2c-bcm2708"

#
# Increase the size (1GB) of root file system
#
IMAGE_ROOTFS_EXTRA_SPACE = "102400"

#
# Disk Space Monitoring during the build
#
BB_DISKMON_DIRS ??= "\
    STOPTASKS,${TMPDIR},1G,100K \
    STOPTASKS,${DL_DIR},1G,100K \
    STOPTASKS,${SSTATE_DIR},1G,100K \
    STOPTASKS,/tmp,100M,100K \
    HALT,${TMPDIR},100M,1K \
    HALT,${DL_DIR},100M,1K \
    HALT,${SSTATE_DIR},100M,1K \
    HALT,/tmp,10M,1K"

# CONF_VERSION is increased each time build/conf/ changes incompatibly and is used to
# track the version of this file when it was generated. This can safely be ignored if
# this doesn't mean anything to you.
CONF_VERSION = "2"

# Enable deletion of temporary workspace to ease hard drive demands during builds.
INHERIT += "rm_work"
```

## meta-dotnet/conf/layer.conf
```bitbake
# We have a conf and classes directory, append to BBPATH
BBPATH .= ":${LAYERDIR}"

# We have a recipes directory, add to BBFILES
BBFILES += "${LAYERDIR}/recipes*/*/*.bb \
            ${LAYERDIR}/recipes*/*/*.bbappend"

BBFILE_COLLECTIONS += "meta-dotnet"
BBFILE_PATTERN_meta-dotnet := "^${LAYERDIR}/"
BBFILE_PRIORITY_meta-dotnet = "7"

LAYERDEPENDS_meta-dotnet = "core"
LAYERSERIES_COMPAT_meta-dotnet = "kirkstone"
```

## meta-rpilinux/conf/layer.conf
```bitbake
# We have a conf and classes directory, append to BBPATH
BBPATH .= ":${LAYERDIR}"

# We have a recipes directory, add to BBFILES
BBFILES += "${LAYERDIR}/recipes*/*/*.bb \
            ${LAYERDIR}/recipes*/*/*.bbappend"

BBFILE_COLLECTIONS += "meta-rpilinux"
BBFILE_PATTERN_meta-rpilinux := "^${LAYERDIR}/"
BBFILE_PRIORITY_meta-rpilinux = "7"

LAYERDEPENDS_meta-rpilinux = "core"
LAYERSERIES_COMPAT_meta-rpilinux = "kirkstone"
```
